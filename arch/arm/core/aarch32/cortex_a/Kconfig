## arch/arm/core/aarch32/cortex_a/Kconfig
```kconfig
# ARM Cortex-A platform configuration options

# Copyright (c) 2020 Henrik Brix Andersen <henrik@brixandersen.dk>
# SPDX-License-Identifier: Apache-2.0

# NOTE: We have the specific core implementations first and outside of the
# if CPU_CORTEX_M block so that SoCs can select which core they are using
# without having to select all the options related to that core.  Everything
# else is captured inside the if CPU_CORTEX_M block so they are not exposed
# if one select a differnet ARM Cortex Family (Cortex-M or Cortex-R)

config CPU_CORTEX_A9
	bool
	select CPU_CORTEX_A
	select ARMV7_A
	help
	  This option signifies the use of a Cortex-A9 CPU

if CPU_CORTEX_A

config ARMV7_A
	bool
	select ATOMIC_OPERATIONS_BUILTIN
	select ISA_ARM
	help
	  This option signifies the use of an ARMv7-A processor
	  implementation.

	  From https://developer.arm.com/products/architecture/cpu-architecture/a-profile:
	  The Armv7-A architecture introduced the concept of architecture
	  profiles which has been carried onwards into the Armv8 architectures.
	  It implements a traditional Arm architecture with multiple modes,
	  supports a Virtual Memory System Architecture (VMSA) based on a Memory
	  Management Unit (MMU), and supports the Arm (A32) and Thumb (T32)
	  instruction sets.

config RUNTIME_NMI
	default y

config GEN_ISR_TABLES
	default y

config GEN_IRQ_VECTOR_TABLE
	default n

endif # CPU_CORTEX_A
```

## boards/adafruit/feather_m4_can_express/Kconfig.adafruit_feather_m4_can_express
```kconfig
# Copyright (c) 2024-2025 Henrik Brix Andersen <henrik@brixandersen.dk>
# SPDX-License-Identifier: Apache-2.0

config BOARD_ADAFRUIT_FEATHER_M4_CAN_EXPRESS
	select SOC_SAME51J19A
```

## boards/adafruit/feather_m4_can_express/adafruit_feather_m4_can_express_defconfig
```kconfig
# Copyright (c) 2024-2025 Henrik Brix Andersen <henrik@brixandersen.dk>
# SPDX-License-Identifier: Apache-2.0

# Shared between Atmel SAMD5x and SAME5x
CONFIG_SOC_ATMEL_SAMD5X_XOSC32K=y
CONFIG_SOC_ATMEL_SAMD5X_XOSC32K_AS_MAIN=y

CONFIG_BUILD_OUTPUT_HEX=y
CONFIG_BUILD_OUTPUT_UF2=y
CONFIG_BOOTLOADER_BOSSA=y
CONFIG_BOOTLOADER_BOSSA_ADAFRUIT_UF2=y

CONFIG_ARM_MPU=y
CONFIG_HW_STACK_PROTECTION=y

CONFIG_CONSOLE=y
CONFIG_SERIAL=y
CONFIG_UART_CONSOLE=y
CONFIG_UART_INTERRUPT_DRIVEN=y
```

## boards/adafruit/feather_m4_can_express/board.yml
```yaml
board:
  name: adafruit_feather_m4_can_express
  vendor: adafruit
  socs:
    - name: same51j19a
```

## boards/arm/nrf52_holyiot_yj16032/Kconfig.board
```kconfig
# Kconfig - Holyiot YJ-16032 board configuration
#
# Copyright (c) 2018 Henrik Brix Andersen <henrik@brixandersen.dk>
#
# SPDX-License-Identifier: Apache-2.0

config BOARD_NRF52_HOLYIOT_YJ16032
	bool "Holyiot YJ-16032"
	depends on SOC_NRF52832_QFAA
```

## boards/arm/nrf52_holyiot_yj16032/Kconfig.defconfig
```kconfig
# Kconfig - Holyiot YJ-16032 board configuration
#
# Copyright (c) 2018 Henrik Brix Andersen <henrik@brixandersen.dk>
#
# SPDX-License-Identifier: Apache-2.0

if BOARD_NRF52_HOLYIOT_YJ16032

config BOARD
	default "nrf52_holyiot_yj16032"

config GPIO_AS_PINRESET
	default n

endif # BOARD_NRF52_HOLYIOT_YJ16032
```

## boards/arm/nrf52_holyiot_yj16032/nrf52_holyiot_yj16032_defconfig
```kconfig
CONFIG_ARM=y
CONFIG_SOC_FAMILY_NRF=y
CONFIG_SOC_SERIES_NRF52X=y
CONFIG_SOC_NRF52832_QFAA=y
CONFIG_BOARD_NRF52_HOLYIOT_YJ16032=y

# Enable MPU
CONFIG_ARM_MPU=y

# bluetooth
CONFIG_BT=y
CONFIG_BT_CTLR=y
```

## boards/arm/qemu_cortex_a9/Kconfig.board
```kconfig
# SPDX-License-Identifier: Apache-2.0

config BOARD_QEMU_CORTEX_A9
	bool "Cortex-A9 Emulation (QEMU)"
	depends on SOC_XILINX_ZYNQ_7010
	select QEMU_TARGET
```

## boards/arm/qemu_cortex_a9/Kconfig.defconfig
```kconfig
# SPDX-License-Identifier: Apache-2.0

if BOARD_QEMU_CORTEX_A9

config BUILD_OUTPUT_BIN
	default n

config BOARD
	default "qemu_cortex_a9"

endif # BOARD_QEMU_CORTEX_A9
```

## boards/arm/qemu_cortex_a9/qemu_cortex_a9_defconfig
```kconfig
# SPDX-License-Identifier: Apache-2.0

CONFIG_ARM=y
CONFIG_SOC_XILINX_ZYNQ_7010=y
CONFIG_BOARD_QEMU_CORTEX_A9=y
CONFIG_CONSOLE=y
CONFIG_UART_CONSOLE=y
CONFIG_SERIAL=y
# TODO:
CONFIG_SYS_CLOCK_HW_CYCLES_PER_SEC=100000000
```

## boards/arm/stm32h735g_disco/Kconfig.defconfig
```kconfig
# STM32H735G DISCOVERY board configuration

# Copyright (c) 2021 SILA Embedded Solutions GmbH
# SPDX-License-Identifier: Apache-2.0

if BOARD_STM32H735G_DISCO

config BOARD
	default "stm32h735g_disco"

if NETWORKING

config NET_L2_ETHERNET
	default y

endif # NETWORKING

config SPI_STM32_INTERRUPT
	default y
	depends on SPI

config INPUT
	default y if LVGL

config INPUT_FT5336_INTERRUPT
	default y if INPUT_FT5336

# MEMC needs to be enabled in order to store
# display buffer to external SDRAM connected to FMC
config MEMC
	default y if DISPLAY

endif # BOARD_STM32H735G_DISCO
```

## boards/shields/adafruit_data_logger_shield/Kconfig.defconfig
```kconfig
# Copyright (c) 2019 Henrik Brix Andersen <henrik@brixandersen.dk>
# SPDX-License-Identifier: Apache-2.0

if SHIELD_ADAFRUIT_DATA_LOGGER_SHIELD

if DISK_ACCESS

config SPI
	default y

config DISK_ACCESS_SDHC
	default y

config DISK_ACCESS_SPI_SDHC
	default y

endif # DISK_ACCESS

if COUNTER

config I2C
	default y

config COUNTER_PCF8523
	default y

endif # COUNTER

endif # SHIELD_ADAFRUIT_DATA_LOGGER_SHIELD
```

## boards/shields/ssd13xx/Kconfig.defconfig
```kconfig
# Copyright (c) 2019 Linaro Limited
# SPDX-License-Identifier: Apache-2.0

if SHIELD_SSD1306_128X64 || SHIELD_SSD1306_128X64_SPI || SHIELD_SSD1306_128X32 || SHIELD_SSD1331_96X64 || SHIELD_SH1106_128X64

if DISPLAY

if SHIELD_SSD1306_128X64_SPI || SHIELD_SSD1331_96X64

config SPI
	default y

endif # SHIELD_SSD1306_128X64_SPI || SHIELD_SSD1331_96X64

if SHIELD_SSD1306_128X64 || SHIELD_SSD1306_128X32 || SHIELD_SH1106_128X64

config I2C
	default y

endif # SHIELD_SSD1306_128X64 || SHIELD_SSD1306_128X32 || SHIELD_SH1106_128X64

if SHIELD_SSD1306_128X64 || SHIELD_SSD1306_128X32 || SHIELD_SSD1306_128X64_SPI || SHIELD_SH1106_128X64

config SSD1306
	default y

choice SSD1306_CONTROLLER_TYPE
	default SSD1306_SH1106_COMPATIBLE if SHIELD_SH1106_128X64
endchoice

endif # SHIELD_SSD1306_128X64 || SHIELD_SSD1306_128X32 || SHIELD_SSD1306_128X64_SPI || SHIELD_SH1106_128X64

if SHIELD_SSD1331_96X64

config SSD1331
	default y

endif # SHIELD_SSD1331_96X64

if LVGL

config LVGL_DISPLAY_DEV_NAME
	default "SSD1306" if SSD1306
	default "SSD1331" if SSD1331

config LVGL_HOR_RES_MAX
	default 128

config LVGL_VER_RES_MAX
	default 32 if SHIELD_SSD1306_128X32
	default 64

config LVGL_VDB_SIZE
	default 64

config LVGL_DPI
	default 116 if SHIELD_SH1106_128X64
	default 148

config LVGL_BITS_PER_PIXEL
	default 1

choice LVGL_COLOR_DEPTH
	default LVGL_COLOR_DEPTH_1
endchoice

endif # LVGL

endif # DISPLAY

endif # SHIELD_SSD1306_128X64 || SHIELD_SSD1306_128X64_SPI || SHIELD_SSD1306_128X32 || SHIELD_SSD1331_96X64 || SHIELD_SH1106_128X64
```

## boards/st/stm32h735g_disco/Kconfig.defconfig
```kconfig
# STM32H735G DISCOVERY board configuration

# Copyright (c) 2021 SILA Embedded Solutions GmbH
# SPDX-License-Identifier: Apache-2.0

if BOARD_STM32H735G_DISCO

configdefault NET_L2_ETHERNET
	default y

config SPI_STM32_INTERRUPT
	default y
	depends on SPI

config INPUT
	default y if LVGL

config INPUT_FT5336_INTERRUPT
	default y if INPUT_FT5336

endif # BOARD_STM32H735G_DISCO
```

## boards/weact/usb2canfd/Kconfig.usb2canfd
```kconfig
# Copyright (c) 2024 Henrik Brix Andersen <henrik@brixandersen.dk>
# SPDX-License-Identifier: Apache-2.0

config BOARD_USB2CANFD
	select SOC_STM32G0B1XX

# TODO: MCUboot defaults, RTT enablement?
```

## boards/weact/usb2canfd/board.yml
```yaml
board:
  name: usb2canfd
  full_name: USB2CANFD V1
  vendor: weact
  socs:
    - name: stm32g0b1xx
```

## drivers/can/Kconfig.sam0
```kconfig
# SAM CAN configuration options
# Copyright (c) 2022 Kamil Serwus
# SPDX-License-Identifier: Apache-2.0

config CAN_SAM0
	bool "Atmel SAM0 CAN driver"
	default y
	depends on DT_HAS_ATMEL_SAM0_CAN_ENABLED
	select CAN_MCAN
	select PINCTRL

config CAN_SAM0_MRAM_LOCATION
	hex "CAN message RAM byte offset to SRAM_BASE_ADDRESS"
	default 0x5000
	depends on SOC_SERIES_SAME51 || SOC_SERIES_SAME54
	help
	  This option specifies the CAN message RAM start address relative to the system RAM base
	  address.

	  On SAME51/SAME54, the CAN message RAM must be placed within the first 64 KB of the system
	  RAM.
```

## drivers/counter/Kconfig.pcf8523
```kconfig
# NXP PCF8523 RTC

# Copyright (c) 2019 Henrik Brix Andersen <henrik@brixandersen.dk>
# SPDX-License-Identifier: Apache-2.0

config COUNTER_PCF8523
	bool "NXP PCF8523 RTC driver"
	depends on I2C && HAS_DTS_I2C
	help
	  Enable the NXP PCF8523 RTC driver.

if COUNTER_PCF8523

config COUNTER_PCF8523_INIT_PRIORITY
	int "Init priority"
	default 60
	help
	  PCF8523 device driver initialization priority. This driver
	  must be initialized after the I2C controller driver.

endif # COUNTER_PCF8523
```

## drivers/display/Kconfig.ssd1331
```kconfig
# SSD1331 display controller configuration options

# Copyright (c) 2020 Henrik Brix Andersen <henrik@brixandersen.dk>
# SPDX-License-Identifier: Apache-2.0

config SSD1331
	bool "SSD1331 display driver"
	depends on SPI
	help
	  Enable driver for SSD1331 display controller.
```

## drivers/gpio/Kconfig.xlnx
```kconfig
# Xilinx GPIO configuration options

# Copyright (c) 2020 Henrik Brix Andersen <henrik@brixandersen.dk>
# SPDX-License-Identifier: Apache-2.0

config GPIO_XLNX_AXI
	bool "Xilinx AXI GPIO driver"
	help
	  Enable Xilinx AXI GPIO v2 driver.

config GPIO_XLNX_AXI_IIC_GPO
	bool "Xilinx AXI IIC GPO driver"
	depends on I2C_XLNX_AXI_IIC
	help
	  Enable Xilinx AXI IIC GPO driver.
```

## drivers/i2s/Kconfig.mcux_flexcomm
```kconfig
# Copyright (c) 2020 Henrik Brix Andersen <henrik@brixandersen.dk>
# SPDX-License-Identifier: Apache-2.0

config I2S_MCUX_FLEXCOMM
	bool "MCUX FLEXCOMM I2S driver"
	depends on HAS_MCUX_FLEXCOMM
	help
	  Enable the MCUX Flexcomm I2S driver.

config I2S_MCUX_FLEXCOMM_NUM_BUFFERS
	int "Number of I2S buffers"
	depends on I2S_MCUX_FLEXCOMM
	default 4
	help
	  Number of I2S queue buffers to use in the MCUX Flexcomm I2S
	  driver. The same amount of buffers will be allocated for
	  both I2S transmit and recieve queues.
```

## drivers/misc/Kconfig.mcux
```kconfig
# NXP MCUX FlexIO configuration options

# Copyright (c) 2021 Henrik Brix Andersen <henrik@brixandersen.dk>
# SPDX-License-Identifier: Apache-2.0

config MCUX_FLEXIO
	bool "NXP MCUX FlexIO driver"
	depends on HAS_MCUX_FLEXIO
	help
	  Enable NXP MCUX FlexIO driver.

config MCUX_FLEXIO_INIT_PRIORITY
	int "Init priority"
	depends on MCUX_FLEXIO
	default 50
	help
	  MCUX FlexIO device driver initialization priority.
```

## drivers/serial/Kconfig.xlnx
```kconfig
# Xilinx UART configuration

# Copyright (c) 2018 Xilinx Inc.
# SPDX-License-Identifier: Apache-2.0

config UART_XLNX_PS
	bool "Xilinx serial driver for MPSoC"
	depends on (SOC_XILINX_ZYNQ_7000 || SOC_XILINX_ZYNQMP)
	select SERIAL_HAS_DRIVER
	help
	  This option enables the UART driver for Xilinx Zynq 7000 and
	  MPSoC platforms.
```
