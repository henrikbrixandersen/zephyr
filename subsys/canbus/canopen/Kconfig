## subsys/canbus/canopen/Kconfig
```kconfig
# SPDX-FileCopyrightText: Copyright (c) 2021-2026 Henrik Brix Andersen <henrik@brixandersen.dk>
#
# SPDX-License-Identifier: Apache-2.0

menuconfig CANOPEN
	bool "CANopen protocol support [EXPERIMENTAL]"
	depends on CAN
	select POLL
	select SMF
	select SMF_ANCESTOR_SUPPORT
	select SMF_INITIAL_TRANSITION
	select EXPERIMENTAL
	help
	  Enable CANopen (EN 50325-4) (CiA 301) protocol
	  support.

if CANOPEN

module = CANOPEN
module-str = CANopen
source "subsys/logging/Kconfig.template.log_config"
source "kernel/Kconfig.template.workqueue"

config CANOPEN_SHELL
	bool "CANopen shell"
	depends on SHELL
	select CANOPEN_OD_INFO
	help
	  Enable the CANopen shell module.


config CANOPEN_OD_INFO
	bool "Store CANopen object dictionary information"
	help
	  Store CANopen object dictionary information in an iterable section. This allows object
	  dictionary clients to automatically discover the available CANopen object dictionaries at
	  run-time.

config CANOPEN_NMT_EVENT_MSGQ_SIZE
	int "Network Management (NMT) event message queue size"
	range 1 $(UINT32_MAX)
	default 10
	help
	  Number of per-instance NMT events that can be queued for the finite-state machine.

config CANOPEN_SDO_REQUEST_MSGQ_SIZE
	int "Service Data Object (SDO) request message queue size"
	range 1 $(UINT32_MAX)
	default 3
	help
	  Number of per-instance SDO requests that can be queued for the SDO server protocol engine.

	  Since SDO is a confirmed service (using a request/response protocol between one SDO client
	  and one SDO server), a node on a well-behaved CANopen network will only require one SDO
	  request to be enqueued at any point in time.

	  However, if multiple SDO clients attempt to access the same SDO server simultaneously, the
	  protocol engine needs to be able to enqueue multiple requests in order to properly abort
	  the conflicting SDO requests.

config CANOPEN_INDICATORS
	bool "CANopen indicators"
	select LED
	help
	  Enable support for CANopen LED indicators (CiA 303-3).

if CANOPEN_INDICATORS

config CANOPEN_INDICATORS_MULTICOLOR_LED_SUPPORT
	bool "Support multi-color LEDs"
	default y
	help
	  Enable support for multi-color CANopen indicator LEDs.

config CANOPEN_INDICATORS_STATUS_LED_SUPPORT
	bool "Support bicolor CANopen status LEDs"
	default y
	select CANOPEN_INDICATORS_MULTICOLOR_LED_SUPPORT
	help
	  Enable support for bicolor CANopen status LEDs.

endif # CANOPEN_INDICATORS

endif # CANOPEN
```
