## drivers/usb/udc/Kconfig.sam
```kconfig
# Copyright (c) 2025 Henrik Brix Andersen <henrik@brixandersen.dk>
# Copyright (c) 2025 Nordic Semiconductor ASA
# SPDX-License-Identifier: Apache-2.0

config UDC_SAM_USBHS
	bool "Driver for SAM family USB HS device controller"
	default y
	depends on DT_HAS_ATMEL_SAM_USBHS_ENABLED
	select UDC_DRIVER_HAS_HIGH_SPEED_SUPPORT
	select PINCTRL
	select SYS_MEM_BLOCKS # TODO: needed?
	select EVENTS
	help
	  Driver for SAM family USB HS device controller.

if UDC_SAM_USBHS

config UDC_SAM_USBHS_STACK_SIZE
	int "UDC controller driver internal thread stack size"
	default 512
	help
	  Device controller driver internal thread stack size.

config UDC_SAM_USBHS_THREAD_PRIORITY
	int "UDC controller driver thread priority"
	default 8
	help
	  Device controller driver thread priority.

endif # UDC_SAM_USBHS
```

## drivers/watchdog/Kconfig.neorv32
```kconfig
# NEORV32 watchdog configuration options

# Copyright (c) 2025 Henrik Brix Andersen <henrik@brixandersen.dk>
# SPDX-License-Identifier: Apache-2.0

config WDT_NEORV32
	bool "NEORV32 WDT driver"
	default y
	depends on DT_HAS_NEORV32_WDT_ENABLED
	depends on SYSCON
	help
	  Enable NEORV32 WDT driver.
```

## dts/bindings/arm/nxp,kinetis-flexio-device.yaml
```yaml
# Copyright (c) 2021 Henrik Brix Andersen <henrik@brixandersen.dk>
# SPDX-License-Identifier: Apache-2.0

description: NXP Kinetis FlexIO device

include: base.yaml

on-bus: flexio

properties:
    timers:
      type: array
      required: false
      description: |
        Array of the FlexIO timer indexes assigned to the device.

    timer-names:
      type: string-array
      required: false
      description: |
        Name of each FlexIO timer.

    shifters:
      type: array
      required: false
      description: |
        Array of the FlexIO shifter indexes assigned to the device.

    shifter-names:
      type: string-array
      required: false
      description: |
        Name of each FlexIO shifter.
```

## dts/bindings/arm/nxp,kinetis-flexio.yaml
```yaml
# Copyright (c) 2021 Henrik Brix Andersen <henrik@brixandersen.dk>
# SPDX-License-Identifier: Apache-2.0

description: NXP Kinetis FlexIO

compatible: "nxp,kinetis-flexio"

include: base.yaml

bus: flexio

properties:
    reg:
      required: true

    clocks:
      required: true

    interrupts:
      required: true
```

## dts/bindings/cpu/arm,cortex-a9.yaml
```yaml
# Copyright (c) 2020 Henrik Brix Andersen <henrik@brixandersen.dk>
# SPDX-License-Identifier: Apache-2.0

description: ARM Cortex-A9 CPU

compatible: "arm,cortex-a9"

include: cpu.yaml
```

## dts/bindings/display/solomon,ssd1306fb-i2c.yaml
```yaml
# Copyright (c) 2020, Marco Peter
# SPDX-License-Identifier: Apache-2.0

description: SSD1306 128x64 dot-matrix display controller on I2C bus

compatible: "solomon,ssd1306fb"

include: ["solomon,ssd13xxfb-common.yaml", "i2c-device.yaml"]
```

## dts/bindings/display/solomon,ssd1306fb-spi.yaml
```yaml
# Copyright (c) 2020, Marco Peter
# SPDX-License-Identifier: Apache-2.0

description: SSD1306 128x64 dot-matrix display controller on SPI bus

compatible: "solomon,ssd1306fb"

include: ["solomon,ssd13xxfb-spi.yaml", "spi-device.yaml"]
```

## dts/bindings/display/solomon,ssd1331fb.yaml
```yaml
# Copyright (c) 2020 Henrik Brix Andersen <henrik@brixandersen.dk>
# SPDX-License-Identifier: Apache-2.0

description: SSD1331 96RGBx64 dot-matrix display controller on SPI bus

compatible: "solomon,ssd1331fb"

include: ["solomon,ssd13xxfb-spi.yaml", "spi-device.yaml"]

properties:
    enable-gpios:
      type: phandle-array
      required: false
      description: Optional VCC enable pin.
```

## dts/bindings/display/solomon,ssd13xxfb-spi.yaml
```yaml
# Copyright (c) 2020, Marco Peter
# SPDX-License-Identifier: Apache-2.0

include: ["solomon,ssd13xxfb-common.yaml", "spi-device.yaml"]

properties:
    data_cmd-gpios:
      type: phandle-array
      required: true
      description: D/C# pin.
```

## dts/bindings/gpio/xlnx,xps-iic-2.00.a-gpo.yaml
```yaml
description: Xilinx AXI IIC IP General Purpose Output

compatible: "xlnx,xps-iic-2.00.a-gpo"

include: [base.yaml, gpio-controller.yaml]

properties:
    ngpios:
      required: true

    label:
      required: true

    "#gpio-cells":
      const: 2

    xlnx,axi-iic:
      type: phandle
      required: true
      description: |
        Parent Xilinx AXI IIC controller

gpio-cells:
  - pin
  - flags
```

## dts/bindings/i2c/xlnx,xps-iic-2.00.a.yaml
```yaml
description: Xilinx AXI IIC IP

compatible: "xlnx,xps-iic-2.00.a"

include: i2c-controller.yaml

properties:
    reg:
      required: true

    interrupts:
      required: true

    xlnx,tsusta:
      type: int
      required: false
      description: |
        Setup time (in terms  of number  of core clock cycles) for a repeated
        START condition.

    xlnx,tsusto:
      type: int
      required: false
      description: |
        Setup time (in terms  of number  of core clock cycles) for a repeated
        STOP condition.

    xlnx,thdsta:
      type: int
      required: false
      description: |
        Hold time (in terms of number of core clock cycles) for a repeated START
        condition.

    xlnx,tsudat:
      type: int
      required: false
      description: |
        Data setup time (in terms  of number  of core clock cycles).

    xlnx,tbuf:
      type: int
      required: false
      description: |
        Bus free time between a START and STOP conditition (in terms of number
        of core clock cycles).

    xlnx,thigh:
      type: int
      required: false
      description: |
        High period (in terms of number of core clock cycles) for the SCL clock.

    xlnx,tlow:
      type: int
      required: false
      description: |
        Low period (in terms of number of core clock cycles) for the SCL clock.

    xlnx,thddat:
      type: int
      required: false
      description: |
        Data hold time (in terms  of number  of core clock cycles).
```

## dts/bindings/i2s/nxp,lpc-i2s.yaml
```yaml
# Copyright (c) 2020 Henrik Brix Andersen <henrik@brixandersen.dk>
# SPDX-License-Identifier: Apache-2.0

description: LPC I2S node

compatible: "nxp,lpc-i2s"

include: i2s-controller.yaml

properties:
    nxp,flexcomm-tx:
      type: phandle
      required: true
      description: Flexcomm node used for I2S transmit function

    nxp,flexcomm-rx:
      type: phandle
      required: true
      description: Flexcomm node used for I2S receive function
```

## dts/bindings/rtc/nxp,pcf8523.yaml
```yaml
# Copyright (c) 2019 Henrik Brix Andersen <henrik@brixandersen.dk>
# SPDX-License-Identifier: Apache-2.0

description: NXP PCF8523 RTC

compatible: "nxp,pcf8523"

include: i2c-device.yaml

properties:
    int-gpios:
      type: phandle-array
      required: false
      description: GPIOs to which the interrupt lines of the chip is connected
```

## dts/bindings/watchdog/neorv32,wdt.yaml
```yaml
description: NEORV32 Watchdog Timer (WDT)

compatible: "neorv32,wdt"

include: base.yaml

properties:
  reg:
    required: true

  syscon:
    type: phandle
    required: true
    description: |
      phandle to syscon (NEORV32 SYSINFO) node.

  lock:
    type: boolean
    description: |
      Lock watchdog control register after enabling the watchdog. The lock is only cleared on system
      reset.

  strict:
    type: boolean
    description: |
      Enable strict mode. This forces a system reset if a locked watchdog control register is
      written or if a wrong watchdog reset password is used.
```

## samples/basic/fade_led/boards/neorv32_neorv32_minimal.conf
```kconfig
# minimal libs
CONFIG_MINIMAL_LIBC=y
CONFIG_CBPRINTF_NANO=y
CONFIG_CBPRINTF_REDUCED_INTEGRAL=y
CONFIG_CBPRINTF_LIBC_SUBSTS=n

# build optimizations
CONFIG_SIZE_OPTIMIZATIONS=y

# no logging, banner, or other output
CONFIG_PWM_LOG_LEVEL_DBG=n
CONFIG_LOG=n
CONFIG_BOOT_BANNER=n
CONFIG_PRINTK=n

# no timer support
CONFIG_SYS_CLOCK_EXISTS=n

# no multithreading
CONFIG_MULTITHREADING=n
```

## samples/subsys/canbus/canopen/sample.yaml
```yaml
sample:
  name: CANopen sample
common:
  tags: can canopen
  depends_on: can
  platform_allow: twr_ke18f
  harness: console
  harness_config:
    type: one_line
    regex:
      - "(.*)CANopen stack initialized"
tests:
  sample.modules.canopennode:
    tags: introduction
```

## soc/arm/xilinx_zynq_7000/Kconfig
```kconfig
# Xilinx Zynq-7000 series

# Copyright (c) 2020 Henrik Brix Andersen <henrik@brixandersen.dk>
# SPDX-License-Identifier: Apache-2.0

config SOC_XILINX_ZYNQ_7000
	bool
	select CPU_CORTEX_A9
	select GIC_V1
	select MULTI_LEVEL_INTERRUPTS
	select 2ND_LEVEL_INTERRUPTS
	select PLATFORM_SPECIFIC_INIT
```

## soc/arm/xilinx_zynq_7000/Kconfig.defconfig
```kconfig
# Xilinx Zynq-7000 series

# Copyright (c) 2020 Henrik Brix Andersen <henrik@brixandersen.dk>
# SPDX-License-Identifier: Apache-2.0

if SOC_XILINX_ZYNQ_7000

config SOC
	default "xilinx_zynq_7000"

config NUM_IRQS
	# TODO:
	default 220

if SERIAL

config UART_XLNX_PS
	default y

endif # SERIAL

# Workaround for not being able to have commas in macro arguments
DT_CHOSEN_Z_FLASH := zephyr,flash

config FLASH_SIZE
	default $(dt_chosen_reg_size_int,$(DT_CHOSEN_Z_FLASH),0,K)

config FLASH_BASE_ADDRESS
	default $(dt_chosen_reg_addr_hex,$(DT_CHOSEN_Z_FLASH))

endif # SOC_XILINX_ZYNQ_7000
```

## soc/arm/xilinx_zynq_7000/Kconfig.soc
```kconfig
# Xilinx Zynq-7000 series

# Copyright (c) 2020 Henrik Brix Andersen <henrik@brixandersen.dk>
# SPDX-License-Identifier: Apache-2.0

config SOC_XILINX_ZYNQ_7010
	bool "Xilinx Zynq-7010"
	select SOC_XILINX_ZYNQ_7000
```

## soc/neorv32/Kconfig
```kconfig
# Copyright (c) 2021,2025 Henrik Brix Andersen <henrik@brixandersen.dk>
# SPDX-License-Identifier: Apache-2.0

config SOC_NEORV32
	select RISCV
	select RISCV_PRIVILEGED
	select RISCV_SOC_HAS_GP_RELATIVE_ADDRESSING
	imply XIP
	# TODO: move below selects to board config
	select RISCV_ISA_RV32I
	select RISCV_ISA_EXT_M
	select RISCV_ISA_EXT_ZICSR
	select RISCV_ISA_EXT_ZIFENCEI
	select ATOMIC_OPERATIONS_C

if SOC_NEORV32

config SOC_NEORV32_VERSION
	hex
	default 0x01110106
	help
	  The targeted NEORV32 version as BCD-coded number. The format is
	  identical to that of the NEORV32 Machine implementation ID (mimpid)
	  register.

endif # SOC_NEORV32
```

## soc/neorv32/Kconfig.soc
```kconfig
# Copyright (c) 2021 Henrik Brix Andersen <henrik@brixandersen.dk>
# SPDX-License-Identifier: Apache-2.0

config SOC_NEORV32
	bool
	help
	  NEORV32 Processor (SoC).

	  The NEORV32 CPU implementation must have the following RISC-V ISA
	  extensions enabled in order to support Zephyr:
	  - M (Integer Multiplication and Division)
	  - Zicsr (Control and Status Register (CSR) Instructions)

config SOC
	default "neorv32" if SOC_NEORV32
```

## subsys/canbus/canopen/Kconfig
```kconfig
# Copyright (c) 2019 - 2021 Vestas Wind Systems A/S
# SPDX-License-Identifier: Apache-2.0

menuconfig CANOPEN
	bool "CANopen protocol support"
	depends on CAN
	help
	  Enable CANopen (EN 50325-4) (CiA301) protocol
	  support.

if CANOPEN

module = CANOPEN
module-str = CANopen
source "subsys/logging/Kconfig.template.log_config"

choice CANOPEN_STACK
	prompt "CANopen Stack"

config CANOPEN_STACK_CANOPENNODE
	bool "CANopenNode"
	select CANOPENNODE
	help
	  CANopenNode stack.

config CANOPEN_STACK_NATIVE
	bool "Native [EXPERIMENTAL]"
	select POLL
	select SMF
	select SMF_ANCESTOR_SUPPORT
	select SMF_INITIAL_TRANSITION
	select EXPERIMENTAL
	help
	  Zephyr native CANopen stack.

endchoice # CANOPEN_STACK

if CANOPEN_STACK_NATIVE

config CANOPEN_SHELL
	bool "CANopen shell"
	depends on SHELL
	select CANOPEN_OD_INFO
	help
	  Enable the CANopen shell module.

config CANOPEN_USE_DEDICATED_WORKQUEUE
	bool "Use a dedicated CANopen workqueue"
	help
	  Use a dedicated workqueue for CANopen protocol stack processing. If not selected, the
	  CANopen protocol stack will use the system workqueue for processing.

if CANOPEN_USE_DEDICATED_WORKQUEUE

config CANOPEN_WORKQUEUE_STACK_SIZE
	int "CANopen workqueue stack size"
	default SYSTEM_WORKQUEUE_STACK_SIZE
	help
	  Size of the stack used for the dedicated CANopen workqueue thread.

config CANOPEN_WORKQUEUE_PRIORITY
	int "CANopen workqueue priority"
	default SYSTEM_WORKQUEUE_PRIORITY
	help
	  Priority level for the dedicated CANopen workqueue thread.

config CANOPEN_WORKQUEUE_NO_YIELD
	bool "CANopen workqueue no yield"
	default SYSTEM_WORKQUEUE_NO_YIELD
	help
	  By default, the CANopen workqueue yields between each work item, to prevent other threads
	  from being starved. Selecting this removes this yield.

config CANOPEN_WORKQUEUE_WORK_TIMEOUT_MS
	int "CANopen workqueue work timeout in milliseconds"
	default SYSTEM_WORKQUEUE_WORK_TIMEOUT_MS
	help
	  Set to 0 to disable work timeout for the CANopen workqueue. Option has no effect if
	  WORKQUEUE_WORK_TIMEOUT is not enabled.

endif # CANOPEN_USE_DEDICATED_WORKQUEUE

config CANOPEN_OD_INFO
	bool "Store CANopen object dictionary information"
	help
	  Store CANopen object dictionary information in an iterable section. This allows object
	  dictionary clients to automatically discover the available CANopen object dictionaries at
	  run-time.

config CANOPEN_NMT_EVENT_MSGQ_SIZE
	int "Network Management (NMT) event message queue size"
	range 1 $(UINT32_MAX)
	default 10
	help
	  Number of per-instance NMT events that can be queued for the finite-state machine.

config CANOPEN_SDO_REQUEST_MSGQ_SIZE
	int "Service Data Object (SDO) request message queue size"
	range 1 $(UINT32_MAX)
	default 3
	help
	  Number of per-instance SDO requests that can be queued for the SDO server protocol engine.

	  Since SDO is a confirmed service (using a request/response protocol between one SDO client
	  and one SDO server), a node on a well-behaved CANopen network will only require one SDO
	  request to be enqueued at any point in time.

	  However, if multiple SDO clients attempt to access the same SDO server simultaneously, the
	  protocol engine needs to be able to enqueue multiple requests in order to properly abort
	  the conflicting SDO requests.

endif # CANOPEN_STACK_NATIVE

endif # CANOPEN
```

## tests/drivers/build_all/entropy/testcase.yaml
```yaml
common:
  build_only: true
  tags:
    - drivers
    - entropy
tests:
  drivers.entropy.build_all:
    platform_allow:
      - native_sim
      - native_sim/native/64
```

## tests/subsys/canbus/canopen/indicators/testcase.yaml
```yaml
common:
  platform_allow:
    - native_sim
    - native_sim/native/64
  integration_platforms:
    - native_sim
    - native_sim/native/64
  tags:
    - can
    - canopen
tests:
  canbus.canopen.indicators:
    extra_args:
      - CONFIG_CANOPEN_INDICATORS_STATUS_LED_SUPPORT=y
      - CONFIG_CANOPEN_INDICATORS_MULTICOLOR_LED_SUPPORT=y
  canbus.canopen.indicators.no_status_led:
    extra_args:
      - CONFIG_CANOPEN_INDICATORS_STATUS_LED_SUPPORT=n
  canbus.canopen.indicators.no_multicolor:
    extra_args:
      - CONFIG_CANOPEN_INDICATORS_STATUS_LED_SUPPORT=n
      - CONFIG_CANOPEN_INDICATORS_MULTICOLOR_LED_SUPPORT=n
```

## tests/subsys/canbus/canopen/od/testcase.yaml
```yaml
tests:
  canbus.canopen.od:
    integration_platforms:
      - native_sim
      - native_sim/native/64
    tags:
      - can
      - canopen
```
