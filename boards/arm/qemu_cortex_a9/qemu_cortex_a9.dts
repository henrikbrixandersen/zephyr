/* SPDX-License-Identifier: Apache-2.0 */

/dts-v1/;

#include <xilinx/zynq-7000.dtsi>

/ {
	model = "QEMU Cortex-A9";
	compatible = "xlnx,zynq-7000-qemu", "xlnx,zynq-7000";

	aliases {
		uart-0 = &uart0;
	};

	chosen {
		zephyr,sram = &sram0;
		zephyr,flash = &flash0;
		zephyr,console = &uart0;
		zephyr,shell-uart = &uart0;
	};
};

&uart0 {
	status = "okay";
	current-speed = <115200>;
};
