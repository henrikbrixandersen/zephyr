## CMakeLists.txt
```
# SPDX-License-Identifier: Apache-2.0

cmake_minimum_required(VERSION 3.28.0)

find_package(Zephyr REQUIRED HINTS $ENV{ZEPHYR_BASE})
project(canopen_conformance)

include(${ZEPHYR_BASE}/samples/subsys/canbus/canopen/common/common.cmake)

# Generate object dictionary headers and implementation files
include(${ZEPHYR_BASE}/cmake/canopen.cmake NO_POLICY_SCOPE)
set(od objdict)
set(od_header ${ZEPHYR_BINARY_DIR}/include/generated/${od}.h)
set(od_impl ${ZEPHYR_BINARY_DIR}/misc/generated/${od}.c)
generate_canopen_objdict_for_target(
  app objdict/${od}.eds
  ${od_header}
  ${od_impl}
)

target_sources(app PRIVATE src/main.c ${od_impl})
```

## Kconfig
```
# SPDX-FileCopyrightText: Copyright (c) 2021-2026 Henrik Brix Andersen <henrik@brixandersen.dk>
#
# SPDX-License-Identifier: Apache-2.0

config SAMPLE_CANOPEN_NODE_ID
	int "CANopen node-ID"
	default 10
	range 1 127
	help
	  7-bit CANopen Node ID

source "Kconfig.zephyr"
```

## sample.yaml
```
sample:
  name: CANopen conformance sample
tests:
  sample.canopen.conformance:
    depends_on: can
    build_only: true
    integration_platforms:
      - native_sim
      - native_sim/native/64
    tags:
      - can
      - canopen
```

## prj.conf
```kconfig
CONFIG_LOG=y
CONFIG_CANOPEN_LOG_LEVEL_DBG=y

CONFIG_CAN=y

CONFIG_CANOPEN=y
CONFIG_CANOPEN_INDICATORS=y
```

## app_bicolor.overlay
```dts
/*
 * SPDX-FileCopyrightText: Copyright (c) 2026 Henrik Brix Andersen <henrik@brixandersen.dk>
 *
 * SPDX-License-Identifier: Apache-2.0
 */

#include "../common/sample_canopen_leds_bicolor.dtsi"
```

## src/main.c
```c
/*
 * SPDX-FileCopyrightText: Copyright (c) 2021-2026 Henrik Brix Andersen <henrik@brixandersen.dk>
 *
 * SPDX-License-Identifier: Apache-2.0
 */

#include <zephyr/canbus/canopen.h>
#include <zephyr/drivers/led.h>
#include <zephyr/kernel.h>
#include <zephyr/logging/log.h>

#include "sample_canopen_leds.h"
#include "objdict.h"

LOG_MODULE_REGISTER(app, CONFIG_CANOPEN_LOG_LEVEL);

struct canopen co;
struct canopen_sdo_server sdo_server;
struct canopen_nmt_state_callback cb;

static void state_callback(struct canopen_nmt *nmt, struct canopen_nmt_state_callback *cb,
			   enum canopen_nmt_state state, uint8_t node_id)
{
	LOG_INF("NMT state: %s, node-ID: %d", canopen_nmt_state_str(state), node_id);
}

int main(void)
{
	const struct device *can = DEVICE_DT_GET(DT_CHOSEN(zephyr_canbus));
	int err;

	if (!device_is_ready(can)) {
		LOG_ERR_DEVICE_NOT_READY(can);
		return -ENODEV;
	}

	/* TODO: use macro */
	co.sdo_servers = &sdo_server;
	co.num_sdo_servers = 1U;

	err = canopen_init(&co, &objdict, can, &red_led, &green_led, CONFIG_SAMPLE_CANOPEN_NODE_ID);
	if (err != 0) {
		LOG_ERR("failed to initialize the CANopen protocol stack (err %d)", err);
		return err;
	}

	canopen_nmt_init_state_callback(&cb, state_callback);

	err = canopen_nmt_add_state_callback(&co.nmt, &cb);
	if (err != 0) {
		LOG_ERR("failed to add NMT state callback (err %d)", err);
		return err;
	}

	/* TODO: move this to nmt.c */
	err = can_start(can);
	if (err != 0) {
		LOG_ERR("failed to start CAN device (err %d)", err);
		return err;
	}

	err = canopen_enable(&co);
	if (err != 0) {
		LOG_ERR("failed to enable the CANopen protocol stack (err %d)", err);
		return err;
	}

	return 0;
}
```
